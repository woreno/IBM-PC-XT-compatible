
BOOT_LOC  EQU 07C00h

;-Teclado--------------------------------
	KB_FLAG_OFF   EQU 22
	; com a FLAG:
	HOLD_STATE		EQU	08H  ; SUSPEND KEY HAS BEEN TOGGLED
	SCROLL_STATE	EQU	10H  ; SCROLL LOCK STATE HAS BEEN TOGGLED
	NUM_STATE		EQU	20H  ; NUM LOCK STATE HAS BEEN TOGGLED
	CAPS_STATE		EQU	40H  ; CAPS LOCK STATE HAS BEEN TOGGLED
	INS_STATE		EQU	80H  ; INSERT STATE IS ACTIVE
; Interrupções
	INT_FLAG		EQU	080H ; INTERRUPT OCCURRENCE FLAG
; Disquetes
	MOTOR_WAIT	    EQU	37	 ; 2 SECS OF COUNTS FOR MOTOR TURN OFF
	TIME_OUT		EQU	80H	 ; ATTACHMENT FAILED TO RESPOND
	BAD_SEEK		EQU	40H	 ; SEEK OPERATION FAILED
	BAD_NEC 		EQU	20H	 ; NEC CONTROLLER HAS FAILED
	BAD_CRC 		EQU	10H	 ; BAD CRC ON DISKETTE READ
	DMA_BOUNDARY	EQU	09H	 ; ATTEMPT TO DMA ACROSS 64K BOUNDARY
	BAD_DMA 		EQU	08H	 ; DMA OVERRUN ON OPERATION
	RECORD_NOT_FND	EQU	04H	 ; REQUESTED SECTOR NOT FOUND
	WRITE_PROTECT	EQU	03H	 ; WRITE ATTEMPTED ON WRITE PROT DISK
	BAD_ADDR_MARK	EQU	02H	 ; ADDRESS MARK NOT FOUND
	BAD_CMD 		EQU	01H	 ; BAD COMMAND PASSED TO DISKETTE I/O
; Horas
	;COUNTS_SEC     EQU	18
	;COUNTS_MIN     EQU	1092
	;COUNTS_HOUR    EQU	65543
	;COUNTS_DAY	EQU 1573040 = 1800B0H
; Sistema
	RESET_FLAG_OFF	EQU 72h

; Arranque ao byte 31.744 (7*4KB+12*256)
BOOTSEG	SEGMENT AT 7C0H
BOOTSEG ENDS

; STACK aos 12KB+256
STACKSEG	EQU 30H	
STACKTOP	EQU 256


ABS0	SEGMENT AT 0
ORG	1DH*4
	video_param_ptr	LABEL	DWORD
ORG	01EH*4			
	disq_pointer	LABEL	DWORD
ORG	01FH*4
	EXT_PTR			LABEL	DWORD
ORG	400H
ABS0		ENDS

; Área de dados da BIOS - aos 16KB
DATA SEGMENT AT 40H
	include B_BDA.INC
		;----------------------------------------
		clock_test		DB ?
		dip_switches    DB ?
		dos_crash		DB ?
		;-Discos duros---------------------------
		drives_map		DB ?
		fdd_number      DB ?
		int13_accesses	DW ? 
		hdd_DBT0		DB 20 dup(?)
		hdd_DBT1		DB 20 dup(?)
		tty_col			DB	?
		tty_row			DB	?
		tty_att			DB	?
		tty_lastRow		DB	?
		tty_lastCol		DB	?
		tty_lastAtt		DB	?
		tty_strbuff		DB	8 dup(?)
		tty_strbuffEnd  DB ?
		SINGLE_STEP_AX		DW ?
		SINGLE_STEP_BX      DW ?
		SINGLE_STEP_SS      DW ?
		SINGLE_STEP_SP      DW ?
		SINGLE_STEP_BP      DW ?
		SINGLE_STEP_DS      DW ?
		SINGLE_STEP_SI		DW ?
		SINGLE_STEP_CS      DW ?
		SINGLE_STEP_IP      DW ?
		SINGLE_STEP_NEXTCS  DW ?
		SINGLE_STEP_NEXTIP  DW ?
		SINGLE_STEP_NEXTOP  DB ?
		SINGLE_STEP_FLAGS   DW ?
		SINGLE_STEP_ON		DB ?
	DataLength EQU $-offset rs232_base
	SINGLE_STEP_CODEIP	DB ?
DATA ENDS

VIDEO_RAM	SEGMENT AT 0B800H
	regen	LABEL	BYTE
	regenw	LABEL	WORD
		DB	16384 DUP(?)
VIDEO_RAM	ENDS
